/*******************************************************************
    Draw bar graphs using an ESP8266 and LED Matrix

    By Brian Lough
    YouTube: https://www.youtube.com/brianlough
    Twitch: https://www.twitch.tv/brianlough
    Twitter: https://twitter.com/witnessmenow

 ********************************************************************/

#include <PxMatrix.h>

#ifdef ESP32

#define P_LAT 22
#define P_A 19
#define P_B 23
#define P_C 18
#define P_D 5
#define P_E 15
#define P_OE 2
hw_timer_t * timer = NULL;
portMUX_TYPE timerMux = portMUX_INITIALIZER_UNLOCKED;

#endif

#ifdef ESP8266

#include <Ticker.h>
Ticker display_ticker;
#define P_LAT 16
#define P_A 5
#define P_B 4
#define P_C 15
#define P_D 12
#define P_E 0
#define P_OE 2

#endif
// Pins for LED MATRIX

uint8_t display_draw_time=0;

//PxMATRIX display(32,16,P_LAT, P_OE,P_A,P_B,P_C);
//PxMATRIX display(64,32,P_LAT, P_OE,P_A,P_B,P_C,P_D);
//PxMATRIX display(64,64,P_LAT, P_OE,P_A,P_B,P_C,P_D,P_E);
PxMATRIX display(64, 32, P_LAT, P_OE, P_A, P_B, P_C, P_D, P_E);

// Some standard colors
uint16_t myRED = display.color565(255, 0, 0);
uint16_t myGREEN = display.color565(0, 255, 0);
uint16_t myBLUE = display.color565(0, 0, 255);
uint16_t myWHITE = display.color565(255, 255, 255);
uint16_t myYELLOW = display.color565(255, 255, 0);
uint16_t myCYAN = display.color565(0, 255, 255);
uint16_t myMAGENTA = display.color565(255, 0, 255);
uint16_t myBLACK = display.color565(0, 0, 0);

uint16_t myCOLORS[8]={myRED,myGREEN,myBLUE,myWHITE,myYELLOW,myCYAN,myMAGENTA,myBLACK};

uint8_t static weather_icons[]={0x00,0x00,0x00,0x00,0x00,0x00,0x00,0x20,0x00,0x00,0x00,0x00,0x00,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0x00
  ,0x00,0x00,0x00,0x00,0x00,0x00,0x00,0x00,0xff,0xe0,0x00,0x00,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0x00
  ,0x00,0x00,0x00,0x00,0xff,0xe0,0x00,0x00,0x00,0x00,0x00,0x00,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0x00
  ,0x00,0x20,0x00,0x00,0x00,0x00,0xff,0xe0,0xff,0xe0,0xff,0xe0,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0x00
  ,0x00,0x00,0xff,0xe0,0x00,0x00,0xff,0xe0,0xff,0xe0,0xff,0xe0,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0x00
  ,0x00,0x00,0x00,0x00,0x00,0x00,0xff,0xe0,0xff,0xe0,0xff,0xe0,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0x00
  ,0x00,0x00,0x00,0x00,0xff,0xe0,0x00,0x00,0x00,0x00,0x00,0x00,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0x00
  ,0x00,0x00,0x00,0x00,0x00,0x00,0x00,0x00,0xff,0xe0,0x00,0x00,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0x00
  ,0x00,0x00,0x00,0x00,0x00,0x00,0x00,0x00,0x00,0x00,0x00,0x00,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0x00
  ,0x00,0x00,0x00,0x00,0x00,0x00,0x00,0x00,0x00,0x00,0x00,0x00,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0x00
};

#ifdef ESP8266
// ISR for display refresh
void display_updater()
{
  display.display(display_draw_time);
}
#endif

#ifdef ESP32
void IRAM_ATTR display_updater(){
  // Increment the counter and set the time of ISR
  portENTER_CRITICAL_ISR(&timerMux);
  display.display(display_draw_time);
  portEXIT_CRITICAL_ISR(&timerMux);
}
#endif


void display_update_enable(bool is_enable)
{

#ifdef ESP8266
  if (is_enable)
    display_ticker.attach(0.002, display_updater);
  else
    display_ticker.detach();
#endif

#ifdef ESP32
  if (is_enable)
  {
    timer = timerBegin(0, 80, true);
    timerAttachInterrupt(timer, &display_updater, true);
    timerAlarmWrite(timer, 2000, true);
    timerAlarmEnable(timer);
  }
  else
  {
    timerDetachInterrupt(timer);
    timerAlarmDisable(timer);
  }
#endif


}

void pixel_time_test(uint8_t draw_time)
{

  Serial.print("Pixel draw latency in us: ");
  unsigned long start_timer=micros();
  display.drawPixel(1,1,0);
  unsigned long delta_timer=micros()-start_timer;
  Serial.println(delta_timer);

  Serial.print("Display update latency in us: ");
  start_timer=micros();
  display.display(draw_time);
  delta_timer=micros()-start_timer;
  Serial.println(delta_timer);


  display.clearDisplay();
  display.setTextColor(myCYAN);
  display.setCursor(2,0);
  display.print("Bar Charts");
  display.setTextColor(myMAGENTA);
  display.setCursor(2,8);
  display.print("By");
  display.setCursor(2,16);
  display.print("Brian");
  display.setCursor(2,24);
  display.print("Lough");

  display_update_enable(true);

  yield();
  delay(3000);

  display_update_enable(false);
}


void setup() {
 Serial.begin(9600);
  // Define your display layout here, e.g. 1/8 step
  display.begin(16);

  // Define your scan pattern here {LINE, ZIGZAG, ZAGGIZ} (default is LINE)
  //display.setScanPattern(LINE);

  // Define multiplex implemention here {BINARY, STRAIGHT} (default is BINARY)
  //display.setMuxPattern(BINARY);

  // Compare draw latency at similar display brightness for standard and fast drawing
  display.setFastUpdate(false);
  Serial.println("Draw test without fast update");
  display_draw_time=15;
  pixel_time_test(display_draw_time);
  Serial.println("Draw test with fast update");
  display.setFastUpdate(true);
  display_draw_time=0;
  pixel_time_test(display_draw_time);

  display.setFastUpdate(false);
  display_draw_time=15;
  display.clearDisplay();
  display_update_enable(true);
  //display.setColorOffset(15,15,0);
}
union single_double{
  uint8_t two[2];
  uint16_t one;
} this_single_double;

// This draws the weather icons
void draw_weather_icon (uint8_t icon)
{
  if (icon>10)
  icon=10;
  for (int yy=0; yy<10;yy++)
  {
    for (int xx=0; xx<10;xx++)
    {
      uint16_t byte_pos=(xx+icon*10)*2+yy*220;
      this_single_double.two[1]=weather_icons[byte_pos];
      this_single_double.two[0]=weather_icons[byte_pos+1];
      display.drawPixel(1+xx,yy,this_single_double.one);
    }
  }
}

int dataPoints[7] = {4, 7, 9, 2, 12, 5, 1};

void autoDrawBarGraph(int x, int y, int width, int height, int data[], int dataSize, uint16_t colour) {
  int barWidth = 1;
  while(((4*barWidth)/3)*dataSize < width){
    //Serial.println(((4*barWidth)/3)*numDataPoints + barWidth/3);
    barWidth++;
  }

  barWidth = barWidth - 1;

  int maxValue = getMaxValue(data, dataSize);

  int multiplier = 1;
  int actualChartHeight = getActualChartHeight(height, maxValue);

  int gapWidth = barWidth/3;

  drawBarGraph(x, y, data, dataSize, colour, barWidth, gapWidth, actualChartHeight, maxValue);
}

int getActualChartHeight(int height, int maxValue){
  int multiplier = 1;
  int actualChartHeight = height;
  if(maxValue < height){
    while(maxValue*multiplier < height){
      multiplier++;
    }
    multiplier = multiplier -1;
    actualChartHeight = maxValue*multiplier;
  } else if(maxValue < height) {
    multiplier++;
    while(maxValue/multiplier > height){
      multiplier++;
    }
    actualChartHeight = maxValue/multiplier; 
  }

  return actualChartHeight;
}

int getMaxValue(int data[], int dataSize){
  int maxValue = data[0];
  for(int i = 1; i < dataSize; i++){
    if(maxValue < data[i]){
      maxValue = data[i];
    }
  }

  return maxValue;
}

void drawBarGraph(int x, int y, int data[], int dataSize, uint16_t colour, int barWidth, int gapWidth, int actualChartHeight, int maxValue){
  
  for(int i = 0; i < dataSize; i++){
    int barX = x + ((gapWidth + barWidth) * i);
    int barHeight = map(data[i], 0, maxValue, 0, actualChartHeight);
    int barY = y- barHeight;
    //int barY = y - (dataPoints[i] * multiplier);
    //int barHeight = y - barY;
    if(barHeight > 0){
      display.fillRect( barX, barY, barWidth, barHeight, colour );
    }
  }
}


int dataSet1[] = {4, 7, 9, 2, 12, 5, 1};
int dataSet1Size = 7;
int dataSet2[] = {20, 34, 60, 26};
int dataSet2Size = 4;
int dataSet3[] = {30, 24, 50, 13};
int dataSet3Size = 4;
void loop() {

  display.clearDisplay();

  int actualHeight = getActualChartHeight(30, 60);
  drawBarGraph(4, 31, dataSet2, dataSet2Size, myBLUE, 6, 8, actualHeight, 60);
  drawBarGraph(11, 31, dataSet3, dataSet3Size, myGREEN, 6, 8, actualHeight, 60);
  //drawBarGraph(2, 30, 62, 30, dataSet2, dataSet2Size, myBLUE, 4, 7, 60);

  delay(8000);
  display.clearDisplay();
  autoDrawBarGraph(2, 30, 62, 30, dataSet1, dataSet1Size, myBLUE);
  
  delay(4000);
  
  display.clearDisplay();
  autoDrawBarGraph(2, 30, 62, 30, dataSet2, dataSet2Size, myGREEN);
  
  delay(4000);
  
  display.clearDisplay();
  autoDrawBarGraph(2, 30, 20, 30, dataSet1, dataSet1Size, myRED);
  
  delay(4000);
  
  display.clearDisplay();
  autoDrawBarGraph(2, 30, 30, 20, dataSet1, dataSet1Size, myBLUE);
  autoDrawBarGraph(32, 30, 30, 20, dataSet1, dataSet1Size, myGREEN);
  
  delay(4000);
  
  display.clearDisplay();
  autoDrawBarGraph(2, 16, 30, 15, dataSet1, dataSet1Size, myRED);
  autoDrawBarGraph(31, 16, 30, 15, dataSet1, dataSet1Size, myBLUE);
  autoDrawBarGraph(2, 30, 30, 15, dataSet1, dataSet1Size, myGREEN);
  autoDrawBarGraph(31, 30, 30, 15, dataSet1, dataSet1Size, myMAGENTA);
  
  delay(4000);
  
}
